&arduino_serial {
    status = "okay";

    w1_0: w1-zephyr-serial-0 {
        compatible = "zephyr,w1-serial";
        #address-cells = <1>;
        #size-cells = <0>;
        status = "okay";

        ds18b20 {
            compatible = "maxim,ds18b20";
            family-code = <0x28>;
            resolution = <12>;
            status = "okay";
        };
    };
};

&usart6_tx_pg14 {
	drive-open-drain;
	bias-pull-up;
};
